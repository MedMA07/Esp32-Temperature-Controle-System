#include <Wire.h>
#include <Adafruit_GFX.h>
#include <Adafruit_SSD1306.h>
#include <WiFi.h>
#include <WebServer.h>
#include <math.h>

//================ WIFI =================
const char* ssid = "ESP32_AP";
const char* password = "12345678";
WebServer server(80);

//================ OLED =================
#define SCREEN_WIDTH 128
#define SCREEN_HEIGHT 64
#define SDA_PIN 21
#define SCL_PIN 22
Adafruit_SSD1306 display(SCREEN_WIDTH, SCREEN_HEIGHT, &Wire, -1);

// ====== LOGO BITMAP ======
static const unsigned char PROGMEM myLogo_bits[] = {
  0x00,0x00,0x00,0x00,0x00,0x00,0x00,0x00,0x00,0x00,0x00,0x00,0x00,0x00,0x00,0x00,0x00,0x00,0x00,0x00,0x00,
  0x00,0x00,0x00,0x00,0x00,0x00,0x00,0x00,0x00,0x00,0x00,0x00,0x00,0x00,0x00,0x00,0x00,0x00,0x00,0x00,0x00,
  0x00,0x00,0x00,0x00,0x00,0x00,0x00,0x00,0x00,0x00,0x00,0x00,0x00,0x00,0x00,0x00,0x00,0x00,0x00,0x00,0x00,
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  0x00,0x00,0x00,0x00,0x00,0x00,0x00,0x00,0x00,0x00,0x00,0x00,0x00,0x00,0x00,0x00 
};
//================ BUTTONS ==============
#define BTN_MENU  32
#define BTN_PLUS  33
#define BTN_MINUS 25
#define BTN_SEL   26

//================ LED ==================
#define LEDpin 15
bool LEDstate = false;

//================ NTC ==================
#define NTCpin 34
float R1 = 10000.0;
float B = 3950.0;
float To = 298.15;

//================ GRAPH =================
#define MAX_VALUES 60
float tempValues[MAX_VALUES] = {0};
int valueIndex = 0;


const int numSamples = 10; // عدد العينات للحصول على قراءة مستقرة
//================ VARIABLES =============
float T_HIGH = 27.0;
float T_LOW  = 24.0;
float HYST   = 2.0;
float tempC = 0.0; 

int menuState = 1;
int selected  = 1;

//================ WEB SIMPLE =============
// --- دالة إرسال البيانات (JSON) لطلب الـ AJAX ---
void handleStatus() {
  String json = "{";
  json += "\"temp\":" + String(tempC, 1) + ","; // إرسال الحرارة بفاصلة واحدة
  json += "\"state\":\"" + String(LEDstate ? "ON" : "OFF") + "\"";
  json += "}";
  server.send(200, "application/json", json);
}

// --- واجهة المستخدم الاحترافية ---
void handleRoot() {
  String html = "<!DOCTYPE html><html><head>";
  html += "<meta charset='UTF-8'><meta name='viewport' content='width=device-width, initial-scale=1.0'>";
  html += "<title>USTO-MB Thermal Control</title>";
  
  html += "<style>";
  html += "body { font-family: 'Segoe UI', sans-serif; background: #f4f7f6; display: flex; justify-content: center; padding: 20px; }";
  html += ".card { background: white; border-radius: 15px; box-shadow: 0 10px 25px rgba(0,0,0,0.1); width: 100%; max-width: 400px; padding: 20px; }";
  html += ".header { text-align: center; color: #2c3e50; border-bottom: 2px solid #e94560; margin-bottom: 20px; }";
  html += ".monitor { background: #1e1e2f; color: #00f2c3; border-radius: 10px; padding: 20px; text-align: center; margin-bottom: 20px; }";
  html += ".temp-val { font-size: 50px; font-weight: bold; }";
  html += ".status-box { margin-top: 10px; font-size: 18px; font-weight: bold; }";
  html += ".btn { width: 100%; padding: 12px; border: none; border-radius: 8px; cursor: pointer; font-weight: bold; transition: 0.3s; margin-top: 5px; background: #e94560; color: white; }";
  html += ".btn:hover { background: #d8344d; }";
  html += "input { width: 100%; padding: 10px; margin: 5px 0; border: 1px solid #ddd; border-radius: 8px; box-sizing: border-box; }";
  html += "label { font-size: 12px; color: #7f8c8d; font-weight: bold; }";
  html += "</style>";

  html += "<script>";
  // كود التحديث التلقائي
  html += "setInterval(function() {";
  html += "  fetch('/status').then(r => r.json()).then(data => {";
  html += "    document.getElementById('t').innerText = data.temp;";
  html += "    var s = document.getElementById('s');";
  html += "    s.innerText = data.state;";
  html += "    s.style.color = (data.state == 'ON' ? '#00f2c3' : '#e94560');";
  html += "  });";
  html += "}, 1000);";

  // دالة إرسال القيم
  html += "function setVal(p) {";
  html += "  var v = document.getElementById(p).value;";
  html += "  fetch('/set?var=' + p + '&val=' + v).then(() => alert('OK! ' + p + ' updated'));";
  html += "}";
  html += "</script>";

  html += "</head><body>";
  html += "<div class='card'>";
  html += "<div class='header'><h2>Control Station</h2></div>";
  
  // شاشة المراقبة
  html += "<div class='monitor'>";
  html += "  <div class='temp-val'><span id='t'>--</span>°C</div>";
  html += "  <div class='status-box'>HEATER: <span id='s'>--</span></div>";
  html += "</div>";

  // مدخلات التعديل
  auto addInput = [&](String id, String label, float val) {
    html += "<label>" + label + "</label>";
    html += "<input type='number' id='" + id + "' value='" + String(val) + "' step='0.5'>";
    html += "<button class='btn' onclick=\"setVal('" + id + "')\">UPDATE " + id + "</button><br><br>";
  };

  addInput("T_HIGH", "HIGH THRESHOLD", T_HIGH);
  addInput("T_LOW", "LOW THRESHOLD", T_LOW);
  addInput("HYST", "HYSTERESIS MARGIN", HYST);

  html += "</div></body></html>";
  server.send(200, "text/html", html);
}




//================ GRAPH =================
void drawGraph(float temp){
  tempValues[valueIndex] = temp;
  valueIndex = (valueIndex+1) % MAX_VALUES;

  display.clearDisplay();
  for(int i=0;i<MAX_VALUES-1;i++){
    int x0 = i*2;
    int x1 = (i+1)*2;
    int y0 = map(tempValues[i], 0, 50, 63, 0);
    int y1 = map(tempValues[i+1], 0, 50, 63, 0);
    display.drawLine(x0, y0, x1, y1, WHITE);
  }
  display.display();
}

//================ MENU 1 (LOGO) ==========
void menu1(){
  display.clearDisplay();

  // رسم logo bitmap
  display.drawBitmap(0, 0, myLogo_bits, 128, 64, WHITE);

  display.display();
}

//================ MENU 2 (TEMP) ==========
void menu2(float tempC){
  display.clearDisplay();
  display.setTextColor(WHITE);

  display.setTextSize(2);
  display.setCursor(0,0);
  display.print("TEMP");

  display.setTextSize(3);
  display.setCursor(10,20);
  display.print(tempC,1);
  display.print((char)247);
  display.print("C");

  display.setTextSize(1);
  display.setCursor(0,55);
  if(LEDstate) display.print("SYSTEM: ON");
  else display.print("SYSTEM: OFF");

  display.display();
}

//================ MENU 3 (PARAM) =========
void menu3(){
  display.clearDisplay();
  display.setTextColor(WHITE);
  display.setTextWrap(false);

  display.setTextSize(2);
  display.setCursor(3,4);  display.print("T_High");
  display.setCursor(3,24); display.print("T_Low");
  display.setCursor(3,45); display.print("Hyst:");

  display.setTextSize(1);
  display.setCursor(78,5);  display.print(T_HIGH);
  display.setCursor(78,25); display.print(T_LOW);
  display.setCursor(78,45); display.print(HYST);

  if(selected==1) display.drawRect(75,2,40,16, WHITE);
  if(selected==2) display.drawRect(75,22,40,16, WHITE);
  if(selected==3) display.drawRect(75,43,40,16, WHITE);

  display.display();
}

//================ SETUP =================
void setup() {

  Serial.begin(115200);

  pinMode(BTN_MENU, INPUT_PULLUP);
  pinMode(BTN_PLUS, INPUT_PULLUP);
  pinMode(BTN_MINUS, INPUT_PULLUP);
  pinMode(BTN_SEL, INPUT_PULLUP);
  pinMode(LEDpin, OUTPUT);

  Wire.begin(SDA_PIN, SCL_PIN);
  delay(100);

  if(!display.begin(SSD1306_SWITCHCAPVCC, 0x3C)) {
    Serial.println("OLED failed");
    while(true);
  }

  display.clearDisplay();
  display.display();

  WiFi.softAP(ssid, password);

WiFi.softAP(ssid, password);
  server.on("/", handleRoot);
  server.on("/status", handleStatus);
  server.on("/set", [](){
    String var = server.arg("var");
    float val = server.arg("val").toFloat();
    if(var == "T_HIGH") T_HIGH = val;
    else if(var == "T_LOW") T_LOW = val;
    else if(var == "HYST") HYST = val;
    server.send(200, "text/plain", "OK");
  });
  server.begin();
}

//================ LOOP ==================
void loop() {
  // ======= استقبال من interface =======
if (Serial.available()) {
    String line = Serial.readStringUntil('\n');
    line.trim();

    if (line.startsWith("T_HIGH:")) {
        T_HIGH = line.substring(7).toFloat();
    }
    else if (line.startsWith("T_LOW:")) {
        T_LOW = line.substring(6).toFloat();
    }
    else if (line.startsWith("HYST:")) {
        HYST = line.substring(5).toFloat();
    }
}
  server.handleClient();

  //---- Temperature ----
// --- التعديل يبدأ هنا ---
  
  float sumVal = 0;
  int samples = 20; // نأخذ 20 قراءة باش القراءة تولي ثابتة بزاف
  
  for (int i = 0; i < samples; i++) {
    sumVal += analogRead(NTCpin);
    delay(2); // تأخير صغير جداً بين القراءات
  }
  
  float val = sumVal / samples; // القراءة المتوسطة (Stable ADC)

  // الحسابات الباقية تبقى كما هي لكنها ستكون أدق الآن
  float Vout = val * 3.3 / 4095.0;
  if(Vout == 0) Vout = 0.001;
  float Rntc = R1 * (3.3 / Vout - 1.0);
  float tempK = 1 / ((log(Rntc / 10000.0) / B) + (1 / To));
  float tempC = tempK - 273.15;


  
  //---- LED Control ----
  if(tempC >= T_HIGH+HYST){ digitalWrite(LEDpin,LOW); LEDstate = false; }
  else if(tempC <= T_LOW-HYST){ digitalWrite(LEDpin,HIGH); LEDstate = true; }

  //---- BUTTON MENU (anti-rebond) ----
  static bool lastBtn = HIGH;
  bool currentBtn = digitalRead(BTN_MENU);

  if(lastBtn == HIGH && currentBtn == LOW){
    menuState++;
    if(menuState > 4) menuState = 1;
    delay(200);
  }
  lastBtn = currentBtn;

  //---- BUTTON PARAM + / - ----
  if(menuState == 3){
    if(digitalRead(BTN_SEL) == LOW){
      selected++;
      if(selected > 3) selected = 1;
      delay(200);
    }

    if(digitalRead(BTN_PLUS) == LOW){
      if(selected == 1) T_HIGH += 0.5;
      if(selected == 2) T_LOW  += 0.5;
      if(selected == 3) HYST   += 0.5;
      delay(200);
    }

    if(digitalRead(BTN_MINUS) == LOW){
      if(selected == 1) T_HIGH -= 0.5;
      if(selected == 2) T_LOW  -= 0.5;
      if(selected == 3) HYST   -= 0.5;
      delay(200);
    }
  }

  //================ DISPLAY =================
  if(menuState == 1) menu1();
  else if(menuState == 2) menu2(tempC);
  else if(menuState == 3) menu3();
  else if(menuState == 4) drawGraph(tempC);
  Serial.print("Temp: ");
  Serial.print(tempC);
  Serial.print(" | T_HIGH: ");
  Serial.print(T_HIGH);
  Serial.print(" | T_LOW: ");
  Serial.print(T_LOW);
  Serial.print(" | HYST: ");
  Serial.println(HYST);


  delay(200);
}
